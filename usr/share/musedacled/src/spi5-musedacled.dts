/dts-v1/;
/plugin/;

/ {
    compatible = "brcm,bcm2711";

    fragment@0 {
        target-path = "/soc/spi@7e204a00";
        __overlay__ {
            #address-cells = <1>;
            #size-cells = <0>;

            musedacled@0 {
                compatible = "musedacled";
                reg = <0>;  // uses CS0 = GPIO26
                spi-max-frequency = <8000000>;
            };
        };
    };
};
